## conf/layer.conf
```bitbake
# We have a conf and classes directory, add to BBPATH
BBPATH .= ":${LAYERDIR}"

# We have a recipes-* directories, add to BBFILES
BBFILES += "${LAYERDIR}/recipes-*/*/*.bb \
	${LAYERDIR}/recipes-*/*/*.bbappend"

BBFILE_COLLECTIONS += "meta-samsung"
BBFILE_PATTERN_meta-samsung = "^${LAYERDIR}/"
BBFILE_PRIORITY_meta-samsung = "5"

LAYERSERIES_COMPAT_meta-samsung = "sumo thud warrior"
```

## conf/machine/nanopc-t3.conf
```bitbake
#@TYPE: Machine
#@NAME: FriendlyElec NanoPC-T3 Baseboard
#@DESCRIPTION: A Samsung based development board http://wiki.friendlyarm.com/wiki/index.php/NanoPC-T3

require conf/machine/include/arm/arch-arm64.inc

PREFERRED_PROVIDER_virtual/bootloader ?= "u-boot-nexell"
UBOOT_MACHINE ?= "s5p6818_nanopi3_defconfig"
UBOOT_BINARY ?= "fip-nonsecure.img"

PREFERRED_PROVIDER_virtual/kernel ?= "linux-nexell"
KERNEL_IMAGETYPE = "Image"
KERNEL_DEVICETREE = "nexell/s5p6818-nanopi3-rev01.dtb \
		     nexell/s5p6818-nanopi3-rev02.dtb \
		     nexell/s5p6818-nanopi3-rev03.dtb \
		     nexell/s5p6818-nanopi3-rev05.dtb \
		     nexell/s5p6818-nanopi3-rev07.dtb \
		    "
KBUILD_DEFCONFIG = "nanopi3_linux_defconfig"

MACHINE_EXTRA_RRECOMMENDS += "kernel-modules"

EXTRA_IMAGEDEPENDS += "bl1-s5p6818 l-loader-s5p6818 arm-trusted-firmware-s5p6818 u-boot-nexell"

IMAGE_FSTYPES_append = " wic"
WKS_FILE ?= "nanopi3-bsp-image.wks"

IMAGE_BOOT_FILES ?= " \
    s5p6818-nanopi3-*.dtb \
    Image \
    fip-nonsecure.img \
    "

SERIAL_CONSOLES = "115200;ttySAC0"
```

## conf/machine/nanopis2.conf
```bitbake
#@TYPE: Machine
#@NAME: FriendlyElec NanoPi S2 Fire Baseboard
#@DESCRIPTION: A Samsung based development board http://wiki.friendlyarm.com/wiki/index.php/NanoPi_S2

require conf/machine/include/arm/arch-armv7a.inc

PREFERRED_PROVIDER_virtual/bootloader ?= "u-boot-nexell"
UBOOT_MACHINE ?= "s5p4418_nanopi2_defconfig"
UBOOT_BINARY ?= "bootloader.img"

PREFERRED_PROVIDER_virtual/kernel ?= "linux-nexell"
KERNEL_IMAGETYPE = "zImage"
KERNEL_DEVICETREE = "s5p4418-nanopi2-rev01.dtb \
		     s5p4418-nanopi2-rev02.dtb \
		     s5p4418-nanopi2-rev03.dtb \
		     s5p4418-nanopi2-rev04.dtb \
		     s5p4418-nanopi2-rev07.dtb \
		     s5p4418-nanopi2-rev103.dtb \
		    "
KBUILD_DEFCONFIG = "nanopi2_linux_defconfig"

MACHINE_EXTRA_RRECOMMENDS += "kernel-modules"

EXTRA_IMAGEDEPENDS += "bl1-s5p4418 l-loader-s5p4418 u-boot-nexell"

IMAGE_FSTYPES_append = " wic"
WKS_FILE ?= "nanopi2-bsp-image.wks"

IMAGE_BOOT_FILES ?= " \
    s5p4418-nanopi2-*.dtb \
    zImage \
    bootloader.img \
    "

SERIAL_CONSOLES = "115200;ttyAMA0"
```

## wic/nanopi2-bsp-image.wks
```
#SD Card layout - copied from existing layout in https://github.com/friendlyarm/sd-fuse_s5p4418/blob/master/prebuilt/partmap_sd.txt
# https://github.com/friendlyarm/sd-fuse_s5p4418/blob/master/fusing.sh
part spl --source rawcopy --sourceparams="file=bl1-mmcboot.bin" --ondisk mmcblk0 --no-table --size=64k
part spl --source rawcopy --sourceparams="file=loader-mmc.img" --ondisk mmcblk0 --no-table --size=192k
part spl --source rawcopy --sourceparams="file=bl_mon.img" --ondisk mmcblk0 --no-table  --size=1664k
part spl --source rawcopy --sourceparams="file=bootloader.img" --ondisk mmcblk0 --no-table
part /boot --source bootimg-partition --ondisk mmcblk0 --fstype=ext2 --label nanopi2 --active --align 4096 --size 64M
part / --source rootfs --ondisk mmcblk0 --fstype=ext4 --label platform --align 4096
```

## wic/nanopi3-bsp-image.wks
```
#SD Card layout - copied from existing layout in https://github.com/friendlyarm/sd-fuse_s5p6818/blob/master/prebuilt/partmap_sd.txt
# https://github.com/friendlyarm/sd-fuse_s5p6818/blob/master/fusing.sh
part spl --source rawcopy --sourceparams="file=bl1-mmcboot.bin" --ondisk mmcblk0 --no-table --size=64k
part spl --source rawcopy --sourceparams="file=fip-loader.img" --ondisk mmcblk0 --no-table --size=320k
part spl --source rawcopy --sourceparams="file=fip-secure.img" --ondisk mmcblk0 --no-table  --size=1536k
part spl --source rawcopy --sourceparams="file=fip-nonsecure.img" --ondisk mmcblk0 --no-table
part /boot --source bootimg-partition --ondisk mmcblk0 --fstype=ext2 --label nanopi3 --active --align 4096 --size 64M
part / --source rootfs --ondisk mmcblk0 --fstype=ext4 --label platform --align 4096
```
